byte ScanPin[8]={29,26,28,35,32,33,25,23};
byte DataPin[8]={37,27,36,31,22,34,24,30};
byte num;
int T;
byte x;
byte abc=0;
boolean no=0;
boolean Data[8][8]=
{ {1,1,1,1,0,1,1,1}, 
  {1,1,0,1,1,0,1,1}, 
  {1,0,1,1,1,1,0,1},
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  {1,1,1,1,1,1,1,1}, 
};
boolean zero[8][8]=
{ {1,1,1,1,1,1,1,1}, 
  {1,1,1,0,0,1,1,1}, 
  {1,1,0,1,1,0,1,1},
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  {1,1,1,1,1,1,1,1}, 
};
boolean one[8][8]=
{ {1,1,1,1,1,1,1,1}, 
  {1,1,1,1,0,1,1,1}, 
  {1,1,1,0,0,1,1,1},
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  {1,1,1,1,1,1,1,1}, 
};
boolean two[8][8]=
{ {1,1,1,1,1,1,1,1}, 
  {1,1,1,0,0,1,1,1}, 
  {1,1,0,1,1,0,1,1},
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  {1,1,1,1,1,1,1,1}, 
};
boolean three[8][8]=
{ {1,1,1,1,1,1,1,1}, 
  {1,1,1,0,0,1,1,1}, 
  {1,1,0,1,1,0,1,1},
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  {1,1,1,1,1,1,1,1}, 
};
boolean four[8][8]=
{ {1,1,1,1,1,1,1,1}, 
  {1,1,1,1,0,1,1,1}, 
  {1,1,1,0,0,1,1,1},
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  {1,1,1,1,1,1,1,1}, 
};
boolean five[8][8]=
{ {1,1,1,1,1,1,1,1}, 
  {1,1,0,0,0,0,1,1}, 
  {1,1,0,1,1,1,1,1},
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  {1,1,1,1,1,1,1,1}, 
};
boolean six[8][8]=
{ {1,1,1,1,1,1,1,1}, 
  {1,1,0,0,0,0,1,1}, 
  {1,1,0,1,1,1,1,1},
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  {1,1,1,1,1,1,1,1}, 
};
boolean seven[8][8]=
{ {1,1,1,1,1,1,1,1}, 
  {1,1,0,0,0,0,1,1}, 
  {1,1,0,1,1,0,1,1},
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  {1,1,1,1,1,1,1,1}, 
};
boolean eight[8][8]=
{ {1,1,1,1,1,1,1,1}, 
  {1,1,1,0,0,1,1,1}, 
  {1,1,0,1,1,0,1,1},
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  {1,1,1,1,1,1,1,1}, 
};
boolean nine[8][8]=
{ {1,1,1,1,1,1,1,1}, 
  {1,1,1,0,0,1,1,1}, 
  {1,1,0,1,1,0,1,1},
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  {1,1,1,1,1,1,1,1}, 
};
void setup()
{
  for (int i=0 ;i<8;i++)
  {
    pinMode(ScanPin[i], OUTPUT);
    pinMode(DataPin[i], OUTPUT);
    Serial.begin(9600);
  }
}
void loop()
{
 for (int i=0; i <8; i++)
  {    
    digitalWrite(ScanPin[i],HIGH);
    for (int j=0; j <8; j++)
    {
      
      if(Data[i][7-j]==0)
      {
        digitalWrite(DataPin[j],LOW);          
      }
      else
      {
        digitalWrite(DataPin[j],HIGH);
      }
     }  
     delay(1);
     for(int j=0;j<8;j++)
     {
      digitalWrite(DataPin[j],HIGH);
      }
     digitalWrite(ScanPin[i] ,LOW);
 }
   T=T+8;                                      //計時 上方迴圈耗時8ms 所以+8
  if(T>=100)                                 //控制跑馬&變動時間 單位ms
  {
    x=DataPin[0];                                 //DataPin橫向跑動 ScanPin縱向跑動
    for(int i=0;i<7;i++)DataPin[i]=DataPin[i+1];
    DataPin[7]=x;
    T=0;         //計時歸零
    }
   if(Serial.available())
 {
   num=Serial.parseInt();
   for(int i=0;i<8;i++)
   {
     for(int j=0;j<8;j++)
     {
       switch(num)
       {
         case 0:Data[i][j]=zero[i][j];break;
         case 1:Data[i][j]=one[i][j];break;
         case 2:Data[i][j]=two[i][j];break;
         case 3:Data[i][j]=three[i][j];break;
         case 4:Data[i][j]=four[i][j];break;
         case 5:Data[i][j]=five[i][j];break;
         case 6:Data[i][j]=six[i][j];break;
         case 7:Data[i][j]=seven[i][j];break;
         case 8:Data[i][j]=eight[i][j];break;
         case 9:Data[i][j]=nine[i][j];break;
         default:no=1;break;
       }    
     }
   }
  }
  if(no==1)
  {
    Serial.println("Sorry.Please enter the number 0~9");
    no=0;
  }
}
